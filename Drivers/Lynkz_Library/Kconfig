## Drivers/Lynkz_Library/drivers/Kconfig.defconfig
```kconfig
# Lynkz drivers configuration options.

# Copyright (c) 2015 Intel Corporation
# SPDX-License-Identifier: Apache-2.0

#
# Driver BMI090L
#
config LYNKZ_BMI090L
    bool "Enable bmi090l driver."
    default n
    help
      This is a config to enable the bmi090l driver for Lynkz projects.

#
# Driver MX25R
#
config LYNKZ_MX25R
    bool "Enable mx25r driver."
    default n
    help
      This is a config to enable the mx25r driver for Lynkz projects.

#
# Driver S76S
#
config LYNKZ_S76S
    bool "Enable s76s driver."
    default n
    help
      This is a config to enable the s76s driver for Lynkz projects.

# Driver DLHR
#
config LYNKZ_DLHR
    bool "Enable dlhr driver."
    default n
    help
      This is a config to enable the dlhr driver for Lynkz projects.

# Driver ELVH
#
config LYNKZ_ELVH
    bool "Enable elvh driver."
    default n
    help
      This is a config to enable the elvh driver for Lynkz projects.

# Driver BATTERY
#
config LYNKZ_BATTERY
    bool "Enable battery driver."
    default n
    help
      This is a config to enable the elvh driver for Lynkz projects.

# Driver ST50H
#
config LYNKZ_ST50H
    bool "Enable ST50H driver."
    default n
    help
      This is a config to enable the ST50H driver for Lynkz projects.
```
